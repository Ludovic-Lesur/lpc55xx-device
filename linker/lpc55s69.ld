/*
 * lpc55s69.ld
 *
 *  Created on: 15 apr. 2025
 *      Author: Ludo
 */
 
__flash_size__ = 630K;
__sramx_size__ = 32K;
__sram_size__ = 256K;
__sram4_power_quad_size__ = 16K;
__sram_usb_size__ = 16K;

INCLUDE "lpc55xx.ld"